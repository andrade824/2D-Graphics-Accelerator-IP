## Yocto Layer/meta-devbox/conf/layer.conf
```bitbake
# We have a conf and classes directory, add to BBPATH
BBPATH .= ":${LAYERDIR}"

# We have recipes-* directories, add to BBFILES
BBFILES += "${LAYERDIR}/recipes-*/*/*.bb \
	${LAYERDIR}/recipes-*/*/*.bbappend"

BBFILE_COLLECTIONS += "devbox"
BBFILE_PATTERN_devbox = "^${LAYERDIR}/"
BBFILE_PRIORITY_devbox = "6"
```

## Yocto Layer/meta-devbox/conf/machine/devbox.conf
```bitbake
#@TYPE: Machine
#@NAME: devbox
#@DESCRIPTION: Machine support for example video game console "DevBox" running on the ZYBO dev board
#
# This machine overlays meta-xilinx's default "zybo" machine to add support for a modified device tree
# and includes kernel modules for any included IP (NES Controller and Sprite Engine).
#
# For details on the ZYBO board:
#     https://www.digilentinc.com/Products/Detail.cfm?Prod=ZYBO
#

require conf/machine/include/tune-zynq.inc
require conf/machine/include/machine-xilinx-default.inc
require conf/machine/include/machine-xilinx-board.inc

MACHINE_FEATURES = "ext2 vfat usbhost usbgadget"

UBOOT_MACHINE = "zynq_zybo_config"

SERIAL_CONSOLE = "115200 ttyPS0"

MACHINE_DEVICETREE := " \
		zybo/zybo-zynq7-board.dtsi \
                devbox/devbox-ip.dtsi \
		devbox/devbox.dts \
		"

# Place driver modules in the root filesystem
MACHINE_ESSENTIAL_EXTRA_RDEPENDS += "kernel-module-nesctrl kernel-module-sprite-engine"

IMAGE_BOOT_FILES += "boot.bin ${MACHINE}.dtb"

EXTRA_IMAGEDEPENDS += "virtual/boot-bin"
```
